## board/hmi/hmi_y6ull/Kconfig
```kconfig
if TARGET_HMI_Y6ULL_14X14 || TARGET_MX6ULL_9X9_EVK

config SYS_BOARD
	default "hmi_y6ull"

config SYS_VENDOR
	default "hmi"

config SYS_CONFIG_NAME
	default "hmi_y6ull"

endif
```
